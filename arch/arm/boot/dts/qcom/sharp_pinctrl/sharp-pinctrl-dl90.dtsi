/* Copyright (c) 2013-2015, The Linux Foundation. All rights reserved.
 *
 * This program is free software; you can redistribute it and/or modify
 * it under the terms of the GNU General Public License version 2 and
 * only version 2 as published by the Free Software Foundation.
 *
 * This program is distributed in the hope that it will be useful,
 * but WITHOUT ANY WARRANTY; without even the implied warranty of
 * MERCHANTABILITY or FITNESS FOR A PARTICULAR PURPOSE.  See the
 * GNU General Public License for more details.
 */

/*****************************************/
/*  Add SHARP include                    */
/*****************************************/
#include "sharp-pinctrl-nfc.dtsi"
#include "sharp-pinctrl-dl90-sdcc.dtsi"
#include "sharp-pinctrl-shdisp.dtsi"
#include "sharp-pinctrl-hayabusa-shdisp.dtsi"
#include "sharp-pinctrl-shflip.dtsi"
#include "sharp-pinctrl-prox.dtsi"
#include "sharp-pinctrl-shgrip.dtsi"
#include "sharp-pinctrl-shub.dtsi"
#include "sharp-pinctrl-wlan.dtsi"
#include "sharp-pinctrl-shfpsensor.dtsi"
