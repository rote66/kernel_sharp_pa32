/* Copyright (c) 2014, The Linux Foundation. All rights reserved.
 *
 * This program is free software; you can redistribute it and/or modify
 * it under the terms of the GNU General Public License version 2 and
 * only version 2 as published by the Free Software Foundation.
 *
 * This program is distributed in the hope that it will be useful,
 * but WITHOUT ANY WARRANTY; without even the implied warranty of
 * MERCHANTABILITY or FITNESS FOR A PARTICULAR PURPOSE.  See the
 * GNU General Public License for more details.
 */

&mdss_mdp {

	/*---------------------*/
	/* LCD Panel (MDP/DSI) */
	/*---------------------*/
	dsi_shdisp_hayabusa_dual_cmd: sharp,shdisp_hayabusa_dual_cmd {
		compatible = "qcom,mdss-dsi-panel";
		status = "disable";
		qcom,mdss-dsi-panel-name = "sharp 1080p cmd mode dsi panel dual";
		qcom,mdss-dsi-panel-type = "dsi_cmd_mode";
		qcom,mdss-dsi-panel-framerate = <120>;
		qcom,mdss-dsi-panel-clockrate = <0 816000000>;
		qcom,mdss-mdp-transfer-time-us = <7816>;
		qcom,mdss-dsi-virtual-channel-id = <0>;
		qcom,mdss-dsi-stream = <0>;
		qcom,mdss-dsi-panel-width = <540>;
		qcom,mdss-dsi-panel-height = <1920>;
		qcom,mdss-dsi-h-front-porch = <32>;
		qcom,mdss-dsi-h-back-porch = <4>;

		qcom,mdss-dsi-h-pulse-width = <4>;
		qcom,mdss-dsi-h-sync-skew = <0>;
		qcom,mdss-dsi-v-back-porch = <12>;
		qcom,mdss-dsi-v-front-porch = <20>;
		qcom,mdss-dsi-v-pulse-width = <2>;
		qcom,mdss-dsi-h-left-border = <0>;
		qcom,mdss-dsi-h-right-border = <0>;
		qcom,mdss-dsi-v-top-border = <0>;
		qcom,mdss-dsi-v-bottom-border = <0>;

		qcom,mdss-dsi-bpp = <24>;
		qcom,mdss-dsi-color-order = "rgb_swap_rgb";
		qcom,mdss-dsi-underflow-color = <0xff>;
		qcom,mdss-dsi-border-color = <0>;
		qcom,mdss-dsi-on-command = [15 01 00 00 00 00 02 FF E0
									15 01 00 00 00 00 02 4C 20
									15 01 00 00 00 00 02 FF 20
									15 01 00 00 00 00 02 68 10
									15 01 00 00 00 00 02 FF 10
									15 01 00 00 00 00 02 BB 03
									15 01 00 00 00 00 02 BA 07
									39 01 00 00 00 00 06 3B 03 08 08 04 04
									05 01 00 00 00 00 02 21 00];
		qcom,mdss-dsi-off-command = [05 01 00 00 78 00 02 28 00
									 05 01 00 00 78 00 02 10 00];
		qcom,mdss-dsi-on-command-state = "dsi_lp_mode";
		qcom,mdss-dsi-off-command-state = "dsi_lp_mode";
		qcom,mdss-dsi-h-sync-pulse = <0>;
		qcom,mdss-dsi-traffic-mode = "non_burst_sync_event";
		qcom,mdss-dsi-bllp-eof-power-mode;
		qcom,mdss-dsi-bllp-power-mode;
		qcom,mdss-dsi-lane-0-state;
		qcom,mdss-dsi-lane-1-state;
		qcom,mdss-dsi-lane-2-state;
		qcom,mdss-dsi-lane-3-state;
		qcom,mdss-dsi-panel-timings = [23 19 07 00 08 05 23 1E 07 08 05 00];
		qcom,mdss-dsi-panel-timings-phy-v2 = [
				23 1E 07 08 05 03 04 A0
				23 1E 07 08 05 03 04 A0
				23 1E 07 08 05 03 04 A0
				23 1E 07 08 05 03 04 A0
				23 19 07 08 05 03 04 A0];
		qcom,mdss-dsi-t-clk-post = <0x0D>;
		qcom,mdss-dsi-t-clk-pre = <0x2D>;
		qcom,mdss-dsi-bl-min-level = <0>;
		qcom,mdss-dsi-bl-max-level = <255>;
		qcom,mdss-dsi-dma-trigger = "trigger_sw";
		qcom,mdss-dsi-mdp-trigger = "none";
		qcom,mdss-dsi-bl-pmic-control-type = "none";

		qcom,mdss-dsi-te-check-enable;
		qcom,mdss-dsi-te-using-te-pin;
		qcom,mdss-dsi-te-pin-select = <1>;
		qcom,mdss-tear-check-sync-cfg-height = <1953>;
		qcom,mdss-tear-check-sync-init-val = <0>;
		qcom,mdss-tear-check-rd-ptr-trigger-intr = <1626>;
		qcom,mdss-tear-check-start-pos = <1612>;
		qcom,mdss-tear-check-frame-rate = <12000>;

		qcom,mdss-dsi-tx-eot-append;
	};
};
