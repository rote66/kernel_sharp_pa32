## drivers/mmc/Kconfig
```kconfig
#
# MMC subsystem configuration
#

menuconfig MMC
	tristate "MMC/SD/SDIO card support"
	depends on HAS_IOMEM
	help
	  This selects MultiMediaCard, Secure Digital and Secure
	  Digital I/O support.

	  If you want MMC/SD/SDIO support, you should say Y here and
	  also to your specific host controller driver.

config MMC_DEBUG
	bool "MMC debugging"
	depends on MMC != n
	help
	  This is an option for use by developers; most people should
	  say N here.  This enables MMC core and driver debugging.

config MMC_PERF_PROFILING
	bool "MMC performance profiling"
	depends on MMC != n
	default n
	help
	  If you say Y here, support will be added for collecting
	  performance numbers at the MMC Queue and Host layers.

config MMC_CUST_SH
	bool "SHARP MMC driver customized"
	depends on MMC
	default n

config MMC_EMMC_CUST_SH
	bool "SHARP eMMC driver customized"
	depends on MMC_CUST_SH
	default n

config DRIVESTRENGTH_EMMC_CUST_SH
	bool "SHARP eMMC customization for drive strength"
	depends on MMC_EMMC_CUST_SH
	default n

config HS400_DRIVER_TYPE_EMMC_CUST_SH
	int "SHARP eMMC customization for driver type in HS400 mode"
	depends on DRIVESTRENGTH_EMMC_CUST_SH
	range 0 4
	default 0

config HS200_DRIVER_TYPE_EMMC_CUST_SH
	int "SHARP eMMC customization for driver type in HS200 mode"
	depends on DRIVESTRENGTH_EMMC_CUST_SH
	range 0 4
	default 0

config HS_DRIVER_TYPE_EMMC_CUST_SH
	int "SHARP eMMC customization for driver type in HS mode"
	depends on DRIVESTRENGTH_EMMC_CUST_SH
	range 0 4
	default 0

config FFU_EMMC_CUST_SH
	bool "SHARP eMMC customization for ffu"
	depends on MMC_EMMC_CUST_SH
	default n

config MMC_BUG_FIX_CUST_SH
	bool "SHARP eMMC customization for bug fix"
	depends on MMC_EMMC_CUST_SH
	default n

config ERR_DETECT_EMMC_CUST_SH
	bool "SHARP eMMC customization for error detect"
	depends on MMC_EMMC_CUST_SH
	default n

config CLKGATE_TIME_EMMC_CUST_SH
	bool "SHARP eMMC customization for clkgate time"
	depends on MMC_EMMC_CUST_SH
	default n

config DISCARD_EMMC_CUST_SH
	bool "SHARP eMMC customization for discard"
	depends on MMC_EMMC_CUST_SH
	default n

config TIMEOUTCTRL_EMMC_CUST_SH
	bool "SHARP eMMC customization for timeout control"
	depends on MMC_EMMC_CUST_SH
	default n

config RW_PROTECT_EMMC_CUST_SH
	bool "SHARP eMMC customization for read/write protect"
	depends on MMC_EMMC_CUST_SH
	default n

config ERR_RETRY_MMC_CUST_SH
	bool "SHARP MMC customization for error retry"
	depends on MMC_CUST_SH
	default n

config MMC_SD_CUST_SH
	bool "SHARP SD driver customized"
	depends on MMC_CUST_SH
	default n

config MMC_SD_ENABLE_ONLY_DDR50_CUST_SH
	bool "SHARP SD driver customized for enable DDR50 mode"
	depends on MMC_SD_CUST_SH
	default n

config MMC_SD_ECO_MODE_CUST_SH
	bool "SHARP SD driver customized for Reduce the noise interference between SD access and DTV"
	depends on MMC_SD_CUST_SH
	default n

config MMC_SD_DISABLE_CLK_SCALE_CUST_SH
	bool "SHARP SD driver customized for disable Clock Scaling"
	depends on MMC_SD_CUST_SH
	default n

config MMC_SD_PENDING_RESUME_CUST_SH
	bool "SHARP SD driver customized for pending resume"
	depends on MMC_SD_CUST_SH
	default n

config MMC_SD_BATTLOG_CUST_SH
	bool "SHARP SD driver customized for logging"
	depends on MMC_SD_CUST_SH
	default n

config CLOCKTIME_MMC_CUST_SH
	bool "SHARP MMC clocktime customized"
	depends on MMC_CUST_SH
	default n

if MMC

source "drivers/mmc/core/Kconfig"

source "drivers/mmc/card/Kconfig"

source "drivers/mmc/host/Kconfig"

endif # MMC
```

## drivers/sharp/Kconfig
```kconfig
#
# SHARP configuration
#

menu "SHARP Device Drivers"

source "drivers/sharp/vold/Kconfig"

# SH_BOOT_CUST start
source "drivers/sharp/shboot/Kconfig"
# SH_BOOT_CUST end
source "drivers/sharp/shterm/Kconfig"
source "drivers/sharp/shbatt/Kconfig"
source "drivers/sharp/shdiag/Kconfig"
source "drivers/sharp/shdisp/Kconfig"
source "drivers/sharp/shtimer/Kconfig"
source "drivers/sharp/proximity/Kconfig"
# NFC/FeliCa driver
source "drivers/sharp/nfc/Kconfig"
#/* SH_AUDIO_DRIVER -> */ /* 21-002 */
source "drivers/sharp/shaudio/Kconfig"
#/* SH_AUDIO_DRIVER <- */ /* 21-002 */

source "drivers/sharp/shlog/Kconfig"
source "drivers/sharp/shtps/Kconfig"
source "drivers/sharp/shflip/Kconfig"
source "drivers/sharp/shgrip/Kconfig"
source "drivers/sharp/shsensor_hub/ml630q790/Kconfig"

source "drivers/sharp/tunerdrv_tmm/Kconfig"
source "drivers/sharp/shfpsensor/Kconfig"

endmenu
```

## drivers/sharp/nfc/Kconfig
```kconfig
#
# TOSHIBA NFC Chip driver Support
#

menu "Toshiba NFC Chip Driver Support"

config TOSHIBA_NFC
    bool
    default n

config TOSHIBA_NFC_GPIO
    bool "TOSHIBA_NFC GPIO Driver"
    select TOSHIBA_NFC
    default n
    ---help---
      Enable the TOSHIBA_NFC GPIO driver for NFC

config TOSHIBA_NFC_I2C
    bool "TOSHIBA_NFC I2C Driver"
    select TOSHIBA_NFC
    default n
    depends on I2C
    ---help---
      Enable the TOSHIBA_NFC I2C driver for NFC

config NFC_HVDD_REGULATOR
    bool

config NFC_HVDD_GPIO
    bool

choice
    prompt "select platform"
    default TOSHIBA_PLATFORM_FS

config TOSHIBA_PLATFORM_FS
    bool "PLATFORM FS"
    select NFC_HVDD_REGULATOR

config TOSHIBA_PLATFORM_MID
    bool "PLATFORM MID"
    select NFC_HVDD_GPIO

endchoice

endmenu
```

## drivers/sharp/shaudio/Kconfig
```kconfig
#
# audio device configuration
#
# CONFIG_SH_AUDIO_DRIVER newly created

menu "SHARP audio driver"

comment "SHARP audio drivers"

config SH_AUDIO_DRIVER_MODEL_NUMBER
	int "SH_AUDIO_DRIVER_MODEL_NUMBER"
	range 0 999
	default "0"

config SH_AUDIO_DRIVER
	tristate "SHARP Audio Driver customized"
	default y

config SH_AUDIO_SMARTAMP
	tristate "SHARP Smart AMP SSM4329"
	default n

endmenu
```

## drivers/sharp/shbatt/Kconfig
```kconfig
#
# Battery Control Configuration
#

menu "SHARP Battery Driver"

comment "Battery Control Configuration"

config PM_SUPPORT_BATT_TRACEABILITY
	bool "SHARP Battery traceability"
	default n

config SBM_HOT_MAINTENANCE_CHARGE
	bool "SHARP Battery SBM maintenance hot charge"
	default n

endmenu
```

## drivers/sharp/shboot/Kconfig
```kconfig
#
# SH Boot Configuration
#

menu "SHBoot driver"

config SHBOOT_CUST
	bool "SHARP BOOT CUSTOMIZE"
	depends on SHSYS_CUST
	default n

endmenu
```

## drivers/sharp/shdisp/Kconfig
```kconfig
#
# LCDC Configuration
#

menu "SHDISP Configuration"

config USES_SHDISP
	bool "There is USES_SHDISP"
	default n


endmenu
```

## drivers/sharp/shflip/Kconfig
```kconfig
# drivers/sharp/shflip/Kconfig

menu "SHARP FLIP Device Drivers"

config SH_FLIP_SWITCH
	bool "SHARP FLIP Device Drivers"
	default n

endmenu
```

## drivers/sharp/shlog/Kconfig
```kconfig
# drivers/sharp/shlog/Kconfig

menu "SHLOG_SYSTEM"

comment "SHLOG_SYSTEM"

config SHLOG_SYSTEM
bool "SHLOG_SYSTEM driver"
default y

config SHLOG_SYSTEM_LOGCAT
bool "enable SHLOG_SYSTEM logcat"
depends on SHLOG_SYSTEM
default n

endmenu

menu "SHLOG_SHLOG"

comment "SHLOG_SHLOG"

config SHLOG_SHLOG
bool "SHARP SHLOG driver"
default y

config SHLOG_SHLOG_MODEM
bool "enable SHARP SHLOG for modem."
depends on SHLOG_SHLOG
default y

config SHLOG_SHLOG_LOGBUF
bool "enable SHARP SHLOG for logbuf."
depends on SHLOG_SHLOG
default y

config SHLOG_SHLOG_RAMOOPS
bool "enable SHARP SHLOG for ramoops."
depends on SHLOG_SHLOG
default n

config SHLOG_SHLOG_TASKLIST
bool "enable SHARP SHLOG for tasks."
depends on SHLOG_SHLOG
default y

config SHLOG_SHLOG_LATESTSTACK
bool "enable SHARP SHLOG for tasks of latest process."
depends on SHLOG_SHLOG
default y

config SHLOG_SHLOG_LOGD
bool "enable SHARP SHLOG for logd."
depends on SHLOG_SHLOG
default y

config SHLOG_SHLOG_LOGGER
bool "enable SHARP SHLOG for logger."
depends on SHLOG_SHLOG
default n

config SHLOG_HANDLE_PANIC
bool "enable SHARP handler for panic."
depends on SHLOG_SHLOG
default y

config SHLOG_HANDLE_SURFACE_FLINGER
bool "enable SHARP handler for reset of surfaceflinger."
depends on SHLOG_SHLOG
default y

config SHLOG_HANDLE_APPLOG
bool "enable SHARP handler for crash of userspace."
depends on SHLOG_SHLOG
default y

config SHLOG_PANIC_ON_PWRKEY
bool "enable SHARP handler to call panic when powerkey pressed."
depends on SHLOG_SHLOG
default y

config SHLOG_PANIC_ON_PWRKEY_TIMEOUT
int "Timeout to call panic when power-key is pressed."
depends on SHLOG_SHLOG
default 4

config SHLOG_PANIC_ON_SUBSYS
bool "enable SHARP handler to call panic when subsystem crashed."
depends on SHLOG_SHLOG
default n

endmenu

menu "SHARP SHLOG driver"

comment "SHARP SHLOG driver"

config SHARP_SHLOG
	tristate "SHARP SHLOG driver base system."
	default n
	help
	  SHARP SHLOG driver base system.

config SHARP_SHLOG_RAMOOPS
	bool "Enable SHARP SHLOG for ramoops."
	depends on SHARP_SHLOG
	default n
	help
	  Enable SHARP SHLOG for ramoops.

config SHARP_SHLOG_TASKLIST
	bool "Enable SHARP SHLOG for tasks."
	depends on SHARP_SHLOG
	default n
	help
	  Enable SHARP SHLOG for tasks.

config SHARP_SHLOG_LATESTSTACK
	bool "Enable SHARP SHLOG for tasks of latest process."
	depends on SHARP_SHLOG
	default n
	help
	  Enable SHARP SHLOG for tasks of latest process.

config SHARP_HANDLE_PANIC
	bool "Enable SHARP handler for panic."
	depends on SHARP_SHLOG
	default n
	help
	  Enable SHARP handler for panic.

config SHARP_HANDLE_DLOAD
	bool "Enable SHARP handler for dload."
	depends on SHARP_SHLOG
	default n
	help
	  Enable SHARP handler for dload.

config SHARP_HANDLE_SURFACE_FLINGER
	bool "Enable SHARP handler for reset of surfaceflinger."
	depends on SHARP_SHLOG
	default n
	help
	  Enable SHARP handler for reset of surfaceflinger.

config SHARP_PANIC_ON_PWRKEY
	bool "Enable SHARP handler to call panic when powerkey pressed."
	depends on SHARP_SHLOG
	default n
	help
	  Enable SHARP handler to call panic when powerkey pressed.

config SHARP_PANIC_ON_PWRKEY_TIMEOUT
	int "Timeout to call panic when power-key is pressed."
	depends on SHARP_SHLOG
	default 4
	help
	  Timeout to call panic when power-key is pressed.

config SHARP_SHLOG_SHOW_ABOOTLOG
	bool "Enable dumping aboot-log after boot."
	depends on SHARP_SHLOG
	default n
	help
	  Enable dumping aboot-log after boot.

endmenu
```

## drivers/sharp/shtps/sy3000/Kconfig
```kconfig
#
# Sharp Touchscreen configuration
#

if TOUCHSCREEN_SHTPS

	config SHTPS_SY3X00_DEV
		tristate "SY3x00 Device"
		default n
		depends on TOUCHSCREEN_SHTPS

	config SHTPS_SY3000_PRJ_000624_1
		tristate "SY3000 PRJ-000624-1"
		default n
		depends on SHTPS_SY3X00_DEV

	config SHTPS_SY3000_PRJ_000624_2
		tristate "SY3000 PRJ-000624-2"
		default n
		depends on SHTPS_SY3X00_DEV

	config SHTPS_SY3000_PRJ_000624_3
		tristate "SY3000 PRJ-000624-3"
		default n
		depends on SHTPS_SY3X00_DEV

endif # TOUCHSCREEN_SHTPS
```

## drivers/sharp/tunerdrv_tmm/Kconfig
```kconfig
# drivers/sharp/tunerdrv/Kconfig

menu "DTV Tuner Configuration(Tmm)"

config DTV_TUNERDEV_TMM
	tristate "set DTV tuner dev.(Tmm)"
	default n


endmenu
```
